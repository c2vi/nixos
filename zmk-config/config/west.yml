## zmk-config/config/west.yml
```yaml
manifest:
  remotes:
    - name: zmkfirmware
      url-base: https://github.com/ufan
  projects:
    - name: zmk
      remote: zmkfirmware
      revision: ptdevice-refactor
      import: app/west.yml
  self:
    path: config
```
